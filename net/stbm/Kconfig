## net/stbm/Kconfig
```kconfig
config STBM
       bool "AUTOSAR Synchronized Time-Base Manager"
       help
       	Following AUTOSAR Standard but modified to working on linux platform

#if STBM

#endif #if STBM
```
